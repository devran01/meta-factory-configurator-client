## conf/layer.conf
```bitbake
# We have a conf and classes directory, add to BBPATH
BBPATH .= ":${LAYERDIR}"

# We have recipes-* directories, add to BBFILES
BBFILES += "${LAYERDIR}/recipes-*/*/*.bb \
	${LAYERDIR}/recipes-*/*/*.bbappend"

BBFILE_COLLECTIONS += "meta-factory-configurator-client"
BBFILE_PATTERN_meta-factory-configurator-client = "^${LAYERDIR}/"
BBFILE_PRIORITY_meta-factory-configurator-client = "98"

LICENSE_PATH += "${LAYERDIR}/files/custom-licenses"

LAYERSERIES_COMPAT_meta-factory-configurator-client = "thud"
```
